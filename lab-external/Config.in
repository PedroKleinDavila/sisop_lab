## lab-external/Config.in
```kconfig
menu "SISOP TP2"
source "$BR2_EXTERNAL_LAB_PATH/package/lab-syscalls/Config.in"
source "$BR2_EXTERNAL_LAB_PATH/package/lab-xtea/Config.in"
source "$BR2_EXTERNAL_LAB_PATH/package/lab-sstf/Config.in"
endmenu
```

## lab-external/configs/lab_x86_defconfig
```kconfig
BR2_i386=y
BR2_x86_pentiumpro=y
BR2_SYSTEM_DHCP=""
BR2_TARGET_GENERIC_GETTY_PORT="ttyS0"
BR2_TARGET_ROOTFS_EXT2=y
BR2_TARGET_ROOTFS_EXT2_SIZE="256M"
# BR2_TARGET_ROOTFS_TAR is not set
BR2_ROOTFS_POST_BUILD_SCRIPT="board/qemu/x86/post-build.sh"
BR2_KERNEL_HEADERS_AS_KERNEL=y
BR2_PACKAGE_HOST_LINUX_HEADERS_CUSTOM_4_13=y
BR2_LINUX_KERNEL=y
BR2_LINUX_KERNEL_CUSTOM_VERSION=y
BR2_LINUX_KERNEL_CUSTOM_VERSION_VALUE="4.13.9"
BR2_LINUX_KERNEL_USE_CUSTOM_CONFIG=y
BR2_LINUX_KERNEL_CUSTOM_CONFIG_FILE="$(BR2_EXTERNAL_LAB_PATH)/board/linux-4.13.9.config"
BR2_PACKAGE_LAB_SYSCALLS=y
BR2_PACKAGE_LAB_XTEA=y
BR2_PACKAGE_LAB_SSTF=y
```

## lab-external/package/lab-sstf/Config.in
```kconfig
config BR2_PACKAGE_LAB_SSTF
	bool "TP2 SSTF I/O scheduler"
	depends on BR2_LINUX_KERNEL
```

## lab-external/package/lab-syscalls/Config.in
```kconfig
config BR2_PACKAGE_LAB_SYSCALLS
	bool "TP2 syscall tests"
	depends on BR2_LINUX_KERNEL
```

## lab-external/package/lab-xtea/Config.in
```kconfig
config BR2_PACKAGE_LAB_XTEA
	bool "TP2 XTEA character driver"
	depends on BR2_LINUX_KERNEL
```
